## src/mainboard/opus/m4/Kconfig
```kconfig
if BOARD_OPUS_M4

config BOARD_SPECIFIC_OPTIONS # dummy
	def_bool = y
	select ARCH_X86
	select CPU_AMD_SOCKET_940
	select NORTHBRIDGE_AMD_AMDK8
	select NORTHBRIDGE_AMD_AMDK8_ROOT_COMPLEX
	select SOUTHBRIDGE_NVIDIA_CK804
	select SUPERIO_SMSC_SMSCSUPERIO
	select HAVE_HARD_RESET
	select HAVE_BUS_CONFIG
	select HAVE_OPTION_TABLE
	select HAVE_PIRQ_TABLE
	select HAVE_MP_TABLE
	select SERIAL_CPU_INIT
	select HAVE_ACPI_TABLES
	select BOARD_ROMSIZE_KB_512

config MAINBOARD_DIR
	string
	default opus/m4

config APIC_ID_OFFSET
	hex
	default 0x10

config SB_HT_CHAIN_ON_BUS0
	int
	default 2

config MAINBOARD_PART_NUMBER
	string
	default "M4"

config HW_MEM_HOLE_SIZEK
	hex
	default 0x100000

config MAX_CPUS
	int
	default 4

config MAX_PHYSICAL_CPUS
	int
	default 2

config HW_MEM_HOLE_SIZE_AUTO_INC
	bool
	default n

config HT_CHAIN_UNITID_BASE
	hex
	default 0

config HT_CHAIN_END_UNITID_BASE
	hex
	default 0x20

config SB_HT_CHAIN_ON_BUS0
	int
	default 2

config IRQ_SLOT_COUNT
	int
	default 11

endif # BOARD_OPUS_M4
```
